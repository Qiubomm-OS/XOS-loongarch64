## arch/x86/Kconfig
```kconfig
# SPDX-License-Identifier: GPL-2.0
config X86
	bool
	default y

config I386
        bool
        default y

config 32BIT
	def_bool y

config SMP
	bool
	default y

config L1_CACHE_SHIFT
        int
        default "4"

config PAGE_SIZE_4KB
	bool
	default y

#
# Define implied options from the CPU selection here
config X86_INTERNODE_CACHE_SHIFT
	int
	default "12" if X86_VSMP
	default X86_L1_CACHE_SHIFT

config X86_L1_CACHE_SHIFT
	int
	default "4"

config DEFAULT_IO_DELAY_TYPE
	int
	default "0"

source "drivers/Kconfig"
source "drivers/firmware/Kconfig"
source "init/Kconfig"
source "lib/Kconfig"
```
